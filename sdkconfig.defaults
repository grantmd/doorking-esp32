## sdkconfig.defaults
```kconfig
# Common defaults shared across all supported targets. Target-specific
# options (flash size, console routing, USB mode) live in
# sdkconfig.defaults.<target> — ESP-IDF picks those up automatically
# based on whatever `idf.py set-target` was last run. Never pin
# CONFIG_IDF_TARGET here; it belongs to the set-target invocation.

# Partition layout: two 1700 KB OTA app slots, no factory partition.
#
# The built-in TWO_OTA layout gives only 1 MB per app slot, which the C5
# build was pushing uncomfortably close to after adding dual-band WiFi 6
# driver code. TWO_OTA_LARGE drops the "factory" fallback slot and grows
# each OTA slot to 1700 KB — a 70 % headroom increase per slot. The
# factory slot is only useful for commercial products where a firmware
# brick is a business problem; for a developer-owned gate controller
# where "plug in USB and reflash" is always 10 seconds away, it is
# zero-value storage. OTA still works exactly the same way: updates
# ping-pong between ota_0 and ota_1 and the bootloader can roll back
# between them.
#
# Fits cleanly on all three supported targets:
#   esp32c3: 4 MB flash  — ~3.4 MB partitioned, ~600 KB unused
#   esp32:  16 MB flash — ~3.4 MB partitioned, ~12 MB unused
#   esp32c5: 8 MB flash  — ~3.4 MB partitioned, ~4 MB unused
CONFIG_PARTITION_TABLE_TWO_OTA_LARGE=y

# 1 kHz FreeRTOS tick gives millisecond-granularity timers for the gate
# state machine (pulse width, travel timeouts, command throttling).
CONFIG_FREERTOS_HZ=1000

# Compiler: treat write-to-string-literal as an error, and optimise for
# size rather than debuggability. -Os (via CONFIG_COMPILER_OPTIMIZATION_SIZE)
# saves 10–25 % on most ESP-IDF builds compared to the default -Og, which
# matters because the C5's driver payload puts us uncomfortably close to
# the 1 MB app partition ceiling. Debug-build ergonomics (preserved stack
# frames, more inline symbols) are less important than runway for new
# features. Assertions stay enabled at the default level.
CONFIG_COMPILER_WARN_WRITE_STRINGS=y
CONFIG_COMPILER_OPTIMIZATION_SIZE=y

# Bump the esp_http_server request-header buffer from the 512 B default.
# Desktop browsers (Chrome/Safari/Firefox) routinely send 600+ bytes of
# headers on a plain form POST — User-Agent, Accept-*, Sec-*, Cookie,
# Upgrade-Insecure-Requests, etc. — and overflow the default, returning
# 431 before the handler ever runs. 2 KB is comfortable headroom.
CONFIG_HTTPD_MAX_REQ_HDR_LEN=2048
CONFIG_HTTPD_MAX_URI_LEN=1024

# OTA rollback: after flashing a new image, the bootloader marks it as
# "pending verify". The firmware must call esp_ota_mark_app_valid() to
# commit. If it crashes or fails to connect within 120 s, the bootloader
# rolls back to the previous OTA slot on the next reboot.
CONFIG_BOOTLOADER_APP_ROLLBACK_ENABLE=y

# mbedTLS content-length buffers. IN must stay at the 16 KB default because
# GitHub's CDN (Fastly) sends TLS records larger than 4 KB during OTA binary
# downloads — a smaller IN buffer causes MBEDTLS_ERR_SSL_UNEXPECTED_MESSAGE
# (-0x7100) to fire mid-stream. OUT can stay small since we only send tiny
# request headers; CONFIG_MBEDTLS_ASYMMETRIC_CONTENT_LEN lets IN and OUT
# differ, so we still save ~12 KB of heap over the fully-symmetric default.
# The mDNS-during-TLS-handshake log noise this previously tried to
# eliminate is now suppressed via esp_log_level_set in main.c instead.
CONFIG_MBEDTLS_ASYMMETRIC_CONTENT_LEN=y
CONFIG_MBEDTLS_SSL_IN_CONTENT_LEN=16384
CONFIG_MBEDTLS_SSL_OUT_CONTENT_LEN=4096
```

## sdkconfig.defaults.esp32
```kconfig
# Target-specific defaults for the SparkFun Thing Plus ESP32 WROOM (USB-C).
# Applied automatically when CONFIG_IDF_TARGET=esp32. Common settings
# shared with all other targets live in sdkconfig.defaults.

# The Thing Plus WROOM ships with 16 MB of onboard flash. Note that our
# CONFIG_PARTITION_TABLE_TWO_OTA layout (inherited from the common
# defaults) only uses the first ~3 MB (NVS + two 1 MB app slots + misc);
# the rest of the 16 MB is currently unused. If the app binary ever grows
# past 1 MB we'll switch to CONFIG_PARTITION_TABLE_CUSTOM with a bigger
# layout — for now the common-across-targets 1 MB slots are the cheaper
# call.
CONFIG_ESPTOOLPY_FLASHSIZE_16MB=y
CONFIG_ESPTOOLPY_FLASHSIZE="16MB"

# Console routes to UART0 (the ESP32 default) which the onboard CH340C
# USB-UART bridge exposes as the USB-C serial device. UART0 is already
# the ESP32's default console destination so no Kconfig override is
# needed; this comment records the intent for future readers.
```

## sdkconfig.defaults.esp32c3
```kconfig
# Target-specific defaults for the Seeed Studio XIAO ESP32-C3.
# Applied automatically when CONFIG_IDF_TARGET=esp32c3. Common settings
# shared with all other targets live in sdkconfig.defaults.

# XIAO ESP32-C3 ships with 4 MB of onboard flash.
CONFIG_ESPTOOLPY_FLASHSIZE_4MB=y
CONFIG_ESPTOOLPY_FLASHSIZE="4MB"

# The XIAO exposes USB Serial/JTAG natively over its USB-C port. Route
# the firmware console there so one USB-C cable does power, logging, and
# flashing without any external USB-UART adapter.
CONFIG_ESP_CONSOLE_USB_SERIAL_JTAG=y
```

## sdkconfig.defaults.esp32c5
```kconfig
# Target-specific defaults for the SparkFun Thing Plus ESP32-C5.
# Applied automatically when CONFIG_IDF_TARGET=esp32c5. Common settings
# shared with all other targets live in sdkconfig.defaults.

# The Thing Plus C5 ships with 8 MB of onboard flash.
CONFIG_ESPTOOLPY_FLASHSIZE_8MB=y
CONFIG_ESPTOOLPY_FLASHSIZE="8MB"

# The ESP32-C5 has a native USB Serial/JTAG peripheral, and the Thing Plus
# routes it directly to the USB-C connector (no external USB-UART bridge).
# Route the firmware console there so one USB-C cable does power, logging,
# and flashing — same UX as the XIAO ESP32-C3.
CONFIG_ESP_CONSOLE_USB_SERIAL_JTAG=y

# Note: the board also has 8 MB of PSRAM wired to the ESP32-C5-WROOM-1
# module, but we don't enable it here — nothing in the firmware needs
# extra heap today and enabling PSRAM grows code size and startup time.
# Turn it on (CONFIG_ESP32C5_SPIRAM_SUPPORT=y + related options) if a
# future feature needs it.

# Disable the 802.15.4 (Thread / Zigbee / Matter radio) stack. The C5
# has 802.15.4 hardware and ESP-IDF enables its driver by default for
# chips that do, but we don't use it — our radio stack is WiFi-only.
# Saves enough app-partition space to matter; the C5 build is already
# the largest of our three targets and has the least headroom under
# the 1 MB CONFIG_PARTITION_TABLE_TWO_OTA app slots.
CONFIG_IEEE802154_ENABLED=n
```
